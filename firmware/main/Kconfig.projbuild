## firmware/main/Kconfig.projbuild
```kconfig
menu "TokenPulse"
    choice TP_BOARD
        prompt "Target board"
        default TP_BOARD_147B
        help
            选择目标硬件。两块板共用 comm/usb/keepawake，只有显示与 UI 不同。

        config TP_BOARD_147B
            bool "ESP32-S3-LCD-1.47B (ST7789 SPI 172x320)"
        config TP_BOARD_43C
            bool "ESP32-S3-Touch-LCD-4.3C (RGB 800x480)"
    endchoice
endmenu
```

## firmware/sdkconfig.defaults
```kconfig
CONFIG_IDF_TARGET="esp32s3"
CONFIG_ESP_DEFAULT_CPU_FREQ_MHZ_240=y
CONFIG_ESPTOOLPY_FLASHSIZE_16MB=y
CONFIG_SPIRAM=y
CONFIG_SPIRAM_MODE_OCT=y
CONFIG_SPIRAM_SPEED_80M=y
CONFIG_PARTITION_TABLE_CUSTOM=y
CONFIG_PARTITION_TABLE_CUSTOM_FILENAME="partitions.csv"
CONFIG_FREERTOS_HZ=1000
# Bigger font for the hero metric (both boards)
CONFIG_LV_FONT_MONTSERRAT_28=y
# TinyUSB CDC + HID composite
CONFIG_TINYUSB_CDC_ENABLED=y
CONFIG_TINYUSB_CDC_COUNT=1
CONFIG_TINYUSB_CDC_RX_BUFSIZE=512
CONFIG_TINYUSB_CDC_TX_BUFSIZE=512
CONFIG_TINYUSB_HID_COUNT=1
```
